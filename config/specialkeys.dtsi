/*
 * Copyright (c) 2024 Thiago Alves
 *
 * SPDX-License-Identifier: MIT
 */

// Hyper Key: ⇧ ⌥ ^ ⌘ (Shift + Alt + Control + Command)
#define LEFT_HYPER             LS(LA(LC(LGUI)))
#define LHYP                   LEFT_HYPER
#define RIGHT_HYPER            RS(RA(RC(RGUI)))
#define RHYP                   RIGHT_HYPER

// Hyper Key function like LG and RG
#define LH(keycode)            LS(LA(LC(LG(keycode))))
#define RH(keycode)            RS(RA(RC(RG(keycode))))

// Meh Key: ⇧ ⌥ ^ (Shift + Alt + Control)
#define LEFT_MEH               LS(LA(LCTRL))
#define LMEH                   LEFT_MEH
#define RIGHT_MEH              RS(RA(RCTRL))
#define RMEH                   RIGHT_MEH

// Meh Key function like LG and RG
#define LM(keycode)            LS(LA(LC(keycode)))
#define RM(keycode)            RS(RA(RC(keycode)))

// Keys I feel should be part of ZMK
#define BACK_TAB               LS(TAB)
#define BTAB                   BACK_TAB

// macOS Keys and common shortcuts
#define MAC_LAUNCHPAD          C_AC_DESKTOP_SHOW_ALL_APPLICATIONS
#define MAC_LP                 MAC_LAUNCHPAD
#define MAC_MISSION_CONTROL    C_AC_DESKTOP_SHOW_ALL_WINDOWS
#define MAC_MC                 MAC_MISSION_CONTROL
#define MAC_SPOTLIGHT          C_AC_SEARCH
#define MAC_SP                 MAC_SPOTLIGHT
#define MAC_CUT                LG(X)
#define MAC_COPY               LG(C)
#define MAC_PASTE              LG(V)
#define MAC_UNDO               LG(Z)
#define MAC_REDO               LG(LS(Z))
#define MAC_APP_WINDOWS        LG(LC(DOWN))   // Show windows from current application
#define MAC_APPWIN             MAC_APP_WINDOWS
#define MAC_NEXT_WINDOW        LG(GRAVE)      // Go to the next window on the same application
#define MAC_WINN               MAC_NEXT_WINDOW
#define MAC_PREVIOUS_WINDOW    LG(TILDE)      // Go to the previous window on the same application
#define MAC_WINP               MAC_PREVIOUS_WINDOW
#define MAC_NEXT_DESKTOP       LG(LC(RIGHT))  // Go to the next virtual desktop
#define MAC_DKTN               MAC_NEXT_DESKTOP
#define MAC_PREVIOUS_DESKTOP   LG(LC(LEFT))   // Go to the previous virtual desktop
#define MAC_DKTP               MAC_PREVIOUS_DESKTOP
#define MAC_FIND_NEXT          LG(G)
#define MAC_FDNXT              MAC_FIND_NEXT
#define MAC_FIND_PREVIOUS      LG(LS(G))
#define MAC_FDPRV              MAC_FIND_PREVIOUS
#define MAC_NEXT_WORD          LA(RIGHT)
#define MAC_WRDN               MAC_NEXT_WORD
#define MAC_PREVIOUS_WORD      LA(LEFT)
#define MAC_WRDP               MAC_PREVIOUS_WORD
#define MAC_START_OF_LINE      LG(LEFT)
#define MAC_STTL               MAC_START_OF_LINE
#define MAC_END_OF_LINE        LG(RIGHT)
#define MAC_ENDL               MAC_END_OF_LINE

// RGB Helpers
#define RGB_RESET              RGB_COLOR_HSB(0, 0, 60)

// Mouse actions
#define MSCRL                  &msc
#define MMOVE                  &mmv
// Mouse scroll directions
#define SCROLL_UP              MOVE_Y(-ZMK_POINTING_DEFAULT_SCRL_VAL)
#define SCRLUP                 SCROLL_UP
#define SCROLL_DOWN            MOVE_Y(ZMK_POINTING_DEFAULT_SCRL_VAL)
#define SCRLDN                 SCROLL_DOWN
#define SCROLL_LEFT            MOVE_X(ZMK_POINTING_DEFAULT_SCRL_VAL)
#define SCRLL                  SCROLL_LEFT
#define SCROLL_RIGHT           MOVE_X(-ZMK_POINTING_DEFAULT_SCRL_VAL)
#define SCRLR                  SCROLL_RIGHT
// Mouse movements
#define MKP_MOVE_LEFT          MMOVE MOVE_LEFT
#define MKP_MOVE_DOWN          MMOVE MOVE_DOWN
#define MKP_MOVE_UP            MMOVE MOVE_UP
#define MKP_MOVE_RIGHT         MMOVE MOVE_RIGHT
// Scroll wheel
#define MKP_SCRL_LEFT          MSCRL SCROLL_LEFT
#define MKP_SCRL_DOWN          MSCRL SCROLL_DOWN
#define MKP_SCRL_UP            MSCRL SCROLL_UP
#define MKP_SCRL_RIGHT         MSCRL SCROLL_RIGHT

// This helper macro allow one to define a normal key with a special output with
// pressing shift. This is useful when you want to create a key that, its
// shifted value, differs from the standard behavior.
#define DEFINE_SHIFT_KEY(_behavior_name, _normal_key, _shifted_key) \
    _behavior_name: _behavior_name {                                \
      compatible = "zmk,behavior-mod-morph";                        \
      #binding-cells = <0>;                                         \
      bindings = <_normal_key>, <_shifted_key>;                     \
      mods = <(MOD_LSFT|MOD_RSFT)>;                                 \
    }

#define DEFINE_DOUBLE_TAP_KEY(_behavior_name, _normal_key, _double_tap_key) \
    _behavior_name: _behavior_name {                                        \
      compatible = "zmk,behavior-tap-dance";                                \
      #binding-cells = <0>;                                                 \
      tapping-term-ms = <200>;                                              \
      bindings = <_normal_key>, <_double_tap_key>;                          \
    };


// Internal helper macro to allow us to define all our reversed number keys.
// This macro should NOT be used outside this file!
#define __NUM_REVERSE(_number, _symbol)  DEFINE_SHIFT_KEY(kp_r ## _number, &kp _symbol, &kp _number)

/ {
  macros {
    // Apple's "F14" / "F15" are the historical brightness-down / brightness-up
    // keys on Mac keyboards. macOS treats these as built-in display brightness
    // even when sent from non-Apple keyboards, whereas the standard HID
    // consumer-page brightness codes (C_BRI_UP/C_BRI_DN) get ignored on recent
    // macOS versions. Wrap them as named macros so keymap-drawer can render
    // them with brightness icons in the MED layer (see support/keymap-config.yaml)
    // without affecting the bare F14/F15 keys on the FUNCTIONS layer.
    bri_up: brightness_up {
      compatible = "zmk,behavior-macro";
      #binding-cells = <0>;
      bindings = <&kp F15>;
    };

    bri_dn: brightness_down {
      compatible = "zmk,behavior-macro";
      #binding-cells = <0>;
      bindings = <&kp F14>;
    };
  };
};
